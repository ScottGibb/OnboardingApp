## conf/layer.conf
```bitbake
# We have a conf and classes directory, add to BBPATH
BBPATH .= ":${LAYERDIR}"

# We have recipes-* directories, add to BBFILES
BBFILES += "${LAYERDIR}/recipes-*/*/*.bb \
            ${LAYERDIR}/recipes-*/*/*.bbappend \
            ${LAYERDIR}/recipes-*/*/*/*.bbappend"


BBFILE_COLLECTIONS += "meta-custom-digi-key"
BBFILE_PATTERN_meta-custom-digi-key = "^${LAYERDIR}/"
BBFILE_PRIORITY_meta-custom-digi-key = "10"
# This layer should be preferred over meta-openembedded

LAYERDEPENDS_meta-custom-digi-key = "core"
LAYERSERIES_COMPAT_meta-custom-digi-key = "dunfell"


## Enable UART for serial port console
ENABLE_UART = "1"
# ENABLE_KGBD = "1"
CMDLINE_append = " console=ttyAMA0,115200"

# I2C Device Driver 
ENABLE_I2C = "1"
```
